//--------------------------------------------------------------------------------------------
//
// Generated by X-HDL VHDL Translator - Version 2.0.0 Feb. 1, 2011
// ?? 3? 16 2016 10:57:25
//
//      Input file      : 
//      Component name  : morph_1d
//      Author          : 
//      Company         : 
//
//      Description     : 
//
//
//--------------------------------------------------------------------------------------------


	module Morph_1D(
		rst_n, 
		clk,
		din,
		din_valid,
		dout_valid, 
		dout
	);
   
	parameter       DW = 14;
	parameter       KSZ = 3;
	parameter       ERO_DIL = 1;

	input           rst_n;
	input           clk;
	input  [DW-1:0] din;
	input           din_valid;
	output          dout_valid;
	output [DW-1:0] dout;
   
  localparam       med_idx = ((KSZ >> 1));
   
   reg [KSZ-1:0]   din_valid_r;
   wire [DW-1:0]   reg_din;
   wire [DW-1:0]   min[0:KSZ-2];
   wire [DW-1:0]   max[0:KSZ-2];
   
   
	always @(posedge clk or negedge rst_n)
	if (((~(rst_n))) == 1'b1)
		 din_valid_r <= #1 {KSZ{1'b0}};
	else 
		 din_valid_r <= #1 ({din_valid_r[KSZ - 2:0], din_valid});
   
   
	register_data #(DW, 1) 
	din_r(
		.rst_n(rst_n),
		.clk(clk), 
		.din_valid(din_valid),
		.din(din),
		.reg_din(reg_din)
	);

   
   MinMax #(DW, 1) 
		cmp_min_max(
			.clk(clk), 
			.valid(din_valid_r[0]),
			.din_a(reg_din), 
			.din_b(din),
			.dout_min(min[0]),
			.dout_max(max[0])
		);
   
	generate
	if (ERO_DIL == 1)
	begin : MAP2	
		begin : xhdl0
			genvar  i;
			for (i = 3; i <= KSZ; i = i + 1)
			begin : gen_cmp_min
					 MinMax #(DW, 1) 
						cmp_min_inst(
							.clk(clk), 
							.valid(din_valid_r[i - 2]),
							.din_a(min[i - 3]), 
							.din_b(din), 
							.dout_min(min[i - 2]),
							.dout_max(max[i - 2])
						);
			end
		end
		assign dout = min[KSZ - 2];
	end
	endgenerate
   
	generate
	if ((~(ERO_DIL == 1)))
	begin : MAP3
		begin : xhdl1
			genvar          i;
			for (i = 3; i <= KSZ; i = i + 1)
			begin : gen_cmp_max
					MinMax #(DW, 1)
					cmp_max_inst(
						.clk(clk),
						.valid(din_valid_r[i - 2]),
						.din_a(max[i - 3]), 
						.din_b(din), 
						.dout_min(min[i - 2]), 
						.dout_max(max[i - 2])
					);
				end
		 end
		 assign dout = max[KSZ - 2];
	end
	endgenerate
   
  assign dout_valid = din_valid_r[KSZ - 1 - med_idx];
   
endmodule
