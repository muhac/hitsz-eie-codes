#include <msp430.h> 
#define uchar unsigned char
#define uint  unsigned int
#define CS_1 P6OUT |= BIT1
#define CS_0 P6OUT &= ~BIT1
#define CLK_1 P6OUT |= BIT2
#define CLK_0 P6OUT &= ~BIT2
#define DIN_1 P6OUT |= BIT0
#define DIN_0 P6OUT &= ~BIT0

unsigned char disp1[38][8]={
{0x3C,0x42,0x42,0x42,0x42,0x42,0x42,0x3C},//0
{0x10,0x18,0x14,0x10,0x10,0x10,0x10,0x10},//1
{0x7E,0x2,0x2,0x7E,0x40,0x40,0x40,0x7E},//2
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{0xFE,0xBA,0x92,0xBA,0x92,0x9A,0xBA,0xFE},//国
};
/**
 * main.c
 */
void Delay_xms(unsigned int x)
{
    unsigned int i,j;
    for(i=0;i<x;i++)
        for(j=0;j<112;j++);
}
//--------------------------------------------
//功能：向MAX7219(U3)写入字节
//入口参数：DATA
//出口参数：无
//说明：
void Write_Max7219_byte(unsigned char DATA)
{
    unsigned char i;
        CS_0;
        for(i=8;i>=1;i--)
          {
            CLK_0;                 //CLK 置低电平
            if (0x80 & DATA)
             {     //若最高位为1
                   DIN_1;
             } else
             {               //若最高位为0
                   DIN_0;
             }
                   DATA=DATA<<1;            //左移一位
                   CLK_1;                 //CLK
           }
}
//-------------------------------------------
//功能：向MAX7219写入数据
//入口参数：address、dat
//出口参数：无
//说明：
void Write_Max7219(unsigned char address, unsigned char dat)
{
     CS_0;
     Write_Max7219_byte(address);           //写入地址，即数码管编号
     Write_Max7219_byte(dat);               //写入数据，即数码管显示数字
     CS_1;
}

void Init_MAX7219(void)
{
    P6DIR |= BIT0 + BIT1 + BIT2;
    Write_Max7219(0x09, 0x00);       //译码方式：BCD码
    Write_Max7219(0x0A, 0x03);       //亮度
    Write_Max7219(0x0B, 0x07);       //扫描界限；8个数码管显示
    Write_Max7219(0x0C, 0x01);       //掉电模式：0，普通模式：1
    Write_Max7219(0x0F, 0x01);       //显示测试：1；测试结束，正常显示：0
    _delay_cycles(500000);
    Write_Max7219(0x0F, 0x00);

}
int main(void)
{
	WDTCTL = WDTPW | WDTHOLD;	// stop watchdog timer
	unsigned char i,j;
	unsigned char test[8]={0x3C,0x42,0x42,0x42,0x42,0x42,0x42,0x3C};
	Delay_xms(50);
	Init_MAX7219();
	/*
	 while(1){
	     for(i=1;i<9;i++)
	 { Write_Max7219(i,0b01010101);}
	     Delay_xms(1000);
	 }
	 */
	while(1)
	 {
	  for(j=0;j<38;j++)
	  {
	  for(i=0;i<8;i++)
	  {Write_Max7219(i+1,disp1[j][i]);_delay_cycles(500000);}
	 _delay_cycles(500000);
	 }
	 }
	return 0;
}
